#define KEYS_LEFT 0 1 2 3 4 5 6 \
                  14 15 16 17 18 19 20 \
                  28 29 30 31 32 33 34 \
                  46 47 48 49 50 51 \
                  66 67 68 69 70

#define KEYS_RIGHT 7 8 9 10 11 12 13 \
                   21 22 23 24 25 26 27 \
                   39 40 41 42 43 44 45 \
                   60 61 62 63 64 65 \
                   77 78 79 80 81

#define THUMBS_LEFT 35 36 54 71 72 73

#define THUMBS_RIGHT 37 38 57 74 75 76

#define THUMBS THUMBS_LEFT THUMBS_RIGHT

# totally working
#TAPPING_TERM 175
#QUICK_TAP 175

#define TAPPING_TERM 200
#define QUICK_TAP 150
#define PRIOR_IDLE 50

/ {
  behaviors {
    hm_l: homerow_mods_left {
        compatible = "zmk,behavior-hold-tap";
        label = "HOMEROW_MODS_LEFT";
        #binding-cells = <2>;
        tapping-term-ms = <TAPPING_TERM>;
        quick_tap_ms = <QUICK_TAP>;
        global-quick-tap;
        flavor = "balanced";
        bindings = <&kp>, <&kp>;
    };
    
    hm_r: homerow_mods_right {
        compatible = "zmk,behavior-hold-tap";
        label = "HOMEROW_MODS_RIGHT";
        #binding-cells = <2>;
        tapping-term-ms = <TAPPING_TERM>;
        quick_tap_ms = <QUICK_TAP>;
        global-quick-tap;
        flavor = "balanced";
        bindings = <&kp>, <&kp>;
    };
  };
};
